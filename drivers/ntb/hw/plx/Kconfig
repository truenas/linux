## drivers/ntb/hw/plx/Kconfig
```kconfig
# SPDX-License-Identifier: GPL-2.0-only
config NTB_PLX
	tristate "PLX Non-Transparent Bridge support"
	depends on X86_64
	help
	 This driver supports PLX NTB on capable hardware.

	 If unsure, say N.
```
