## drivers/infiniband/hw/iw_cxgb4/Kconfig
```kconfig
# SPDX-License-Identifier: GPL-2.0-only
config INFINIBAND_CXGB4
	tristate "Chelsio T4/T5/T6/T7 RDMA Driver (Enhanced Package)"
	depends on CHELSIO_T4 && INET
	depends on INFINIBAND_ADDR_TRANS
	select CHELSIO_LIB
	select GENERIC_ALLOCATOR
	help
	  This is an enhanced iWARP/RDMA driver for the Chelsio T4, T5, T6,
	  and T7 series 1GbE, 10GbE, 25GbE, 40GbE, and 100GbE adapters.
	  
	  This enhanced version includes:
	  - Extended T6/T7 support with additional PCI IDs
	  - Support for T62100 cards
	  - Enhanced performance optimizations
	  - Extended debugging capabilities
	  - Additional storage offload features
	  
	  For general information about Chelsio and our products, visit
	  our website at <http://www.chelsio.com>.

	  For customer support, please visit our customer support page at
	  <http://www.chelsio.com/support.html>.

	  Please send feedback to <linux-bugs@chelsio.com>.

	  To compile this driver as a module, choose M here: the module
	  will be called iw_cxgb4.
```

## drivers/ntb/hw/broadcom/Kconfig
```kconfig
# SPDX-License-Identifier: GPL-2.0-only
config NTB_BROADCOM
	tristate "Broadcom NT2.0 Non-Transparent Bridge support"
	depends on X86_64
	help
	  This driver supports Broadcom NT2.0 NTB devices.

	  If unsure, say N.
```

## drivers/target/lio_ha/Kconfig
```kconfig
# SPDX-License-Identifier: GPL-2.0-only

config LIO_HA
	tristate "TrueNAS LIO HA forwarding module"
	depends on TARGET_CORE && TRUENAS
	help
	  Enables the lio_ha.ko kernel module for TrueNAS High Availability
	  with the Linux LIO iSCSI/FC target stack.

	  On a STANDBY node, lio_ha intercepts all I/O and Task Management
	  Requests before they reach the local backend and forwards them to
	  the ACTIVE node over a private TCP channel.  On failover, a single
	  write clears the forwarding flag; lio_ha restores replicated
	  Persistent Reservation state, opens the local iblock/fileio backends,
	  and stops forwarding -- without any LUN removal or reinsertion.

	  The module is loaded on both ACTIVE and STANDBY nodes.  On ACTIVE
	  it registers the ha_recv fabric driver that accepts forwarded commands
	  and submits them to the local LIO stack on behalf of STANDBY's
	  initiators, preserving correct per-I_T nexus PR checking.

	  If unsure, say N.
```
